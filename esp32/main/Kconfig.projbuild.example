## esp32/main/Kconfig.projbuild.example
```kconfig
menu "Mimir Configuration"

	config WIFI_SSID
        string "WiFi SSID"
        default ""
        help
            SSID (network name) for the example to connect to.

    config WIFI_PASS
        string "WiFi Password"
        default ""
        help
            WiFi password (WPA or WPA2) for the example to use.

    config UDP_ADDR
        string "IPV4 Address"
        default ""
        help
            IPV4 address to which the client example will send data.

    config UDP_PORT
        int "Port"
        range 0 65535
        default 3333
        help
            The remote port to which the client example will send data.

endmenu
```
